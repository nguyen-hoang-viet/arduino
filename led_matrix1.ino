#define CLOCK 10
#define LATCH 11
#define DATA 12

char rows[8] = {B10000000, B01000000, B00100000, B00010000, B00001000, B00000100, B00000010, B00000001};

char columns[][8] = {
  {B11100111, B11011011, B11011011, B10111101, B10000001, B10111101, B10111101, B10111101}, //A
  {B11111111, B10000011, B10111101, B10111101, B10000011, B10111101, B10111101, B10000011}, //B
  {B11100011, B11011101, B10111111, B10111111, B10111111, B10111111, B11011101, B11100011}, //C
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  {B11111111, B11111111, B11111111, B11000011, B11000011, B11111111, B11111111, B11111111} // khoảng cách - '_'
};

char character[] = {'A', 'B', 'C', 'D', 'E', 'F', 'G', 'H', 'I', 'J', 'K', 'L', 'M', 'N', 'O', 'P', 'Q', 'R', 'S', 'T', 'U', 'V', 'W', 'X', 'Y', 'Z', '(', '<', '0', '1', '2', '3', '4', '5', '6', '7', '8', '9', '_' };

char ch;
String s;
int times;

void clears() {
  for (int i = 0; i < 8; i++) {
    digitalWrite(LATCH, LOW);
    shiftOut(DATA, CLOCK, MSBFIRST, B11111111);
    shiftOut(DATA, CLOCK, MSBFIRST, rows[i]);
    digitalWrite(LATCH, HIGH);
  }
}
void input() {
  // nếu có xâu mới đc nhập vào sẽ xóa các phần tử hiện có trong s
  if (Serial.available() > 0)
    s.remove(0);
  // đọc các ký tự và chuyển vào xâu s
  while (Serial.available() > 0) {
    ch = Serial.read();
    s += ch;
    delay(7);
  }
  s.toUpperCase();
  Serial.println(s);

  while (Serial.available() == 0) {
    for (int k = 0; k < s.length(); k++)
      for (int l = 0; l < sizeof(character); l++)
        if (s[k] == character[l]) {
          Serial.println(s[k]);
          //nhapnhay(l);
          chay(l);
        }
    clears();
    delay(1000); // Thời gian chờ sau khi hiển thị xong 1 xâu
    Serial.println();
  }

}

// Hiển thị trên led matrix
void nhapnhay(int x) {
  // biến x lưu vị trí của kí tự trong mảng columns
  for (int i = 0; i < times; i++)
    for (int j = 0; j < 8; j++) {
      digitalWrite(LATCH, LOW);
      shiftOut(DATA, CLOCK, MSBFIRST, columns[x][j]);
      shiftOut(DATA, CLOCK, MSBFIRST, rows[j]);
      digitalWrite(LATCH, HIGH);
    }
  clears();
  delay(100); // Thời gian chuyển giữa 2 ký tự
}

void chay(int x) {
  // biến x lưu vị trí của kí tự trong mảng columns
  for (int k = 0; k <= 8; k++)
    for (int i = 0; i < times; i++)
      for (int j = 0; j < 8; j++) {
        digitalWrite(LATCH, LOW);
        shiftOut(DATA, CLOCK, MSBFIRST, columns[x][j] >> k);
        shiftOut(DATA, CLOCK, MSBFIRST, rows[j]);
        digitalWrite(LATCH, HIGH);
      }
  clears();
  delay(100); // Thời gian chuyển giữa 2 ký tự
}

void setup() {
  // put your setup code here, to run once:
  pinMode(CLOCK, OUTPUT);
  pinMode(LATCH, OUTPUT);
  pinMode(DATA, OUTPUT);
  Serial.begin(9600);
  Serial.println("Enter a string");
}

void loop() {
  // put your main code here, to run repeatedly:
  times = 100; // Thời gian hiển thị ký tự trên led matrix
  input();
}
